## configs/nuc745_defconfig
```kconfig
BR2_arm=y
BR2_BINFMT_FLAT=y
BR2_arm7tdmi=y
BR2_JLEVEL=4
BR2_CCACHE=y
BR2_CCACHE_DIR="$(BASE_DIR)/.buildroot-ccache"
BR2_KERNEL_HEADERS_3_8=y
BR2_BINUTILS_VERSION_2_23_2=y
BR2_GCC_VERSION_4_8_X=y
BR2_TOOLCHAIN_BUILDROOT_LARGEFILE=y
BR2_TOOLCHAIN_BUILDROOT_INET_IPV6=y
BR2_TOOLCHAIN_BUILDROOT_INET_RPC=y
BR2_TOOLCHAIN_BUILDROOT_WCHAR=y
BR2_TOOLCHAIN_BUILDROOT_CXX=y
BR2_PTHREADS_NONE=y
BR2_PACKAGE_BUSYBOX_WATCHDOG=y
BR2_PACKAGE_ZLIB=y
BR2_PACKAGE_NANO=y
BR2_TARGET_ROOTFS_INITRAMFS=y
BR2_TARGET_ROOTFS_ROMFS=y
BR2_TARGET_ROOTFS_SQUASHFS=y
BR2_LINUX_KERNEL=y
BR2_LINUX_KERNEL_CUSTOM_GIT=y
BR2_LINUX_KERNEL_CUSTOM_GIT_REPO_URL="git://github.com/Malvineous/linux-nuc700.git"
BR2_LINUX_KERNEL_USE_CUSTOM_CONFIG=y
BR2_LINUX_KERNEL_CUSTOM_CONFIG_FILE="board/nuvoton/nuc745/linux-3.8.config"
BR2_LINUX_KERNEL_ZIMAGE=y
```
